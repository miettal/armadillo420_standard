## linux-2.6.26-at22/arch/arm/mach-mx3/Kconfig
```kconfig
menu "MX3 Options"
	depends on ARCH_MX3

choice
	prompt "Platform"
	depends on ARCH_MX3
	default MACH_MX31ADS

config MACH_ARMADILLO500
	bool "Armadillo-500 (Development Base Board)"

config MACH_ARMADILLO500FX
	bool "Armadillo-500 FX"

config MACH_MX31ADS
	bool "MX31ADS"
	help
	  Include support for MX31ADS platform. This includes specific
	  configurations for the board and its peripherals.

endchoice

config MX3_DOZE_DURING_IDLE
	bool "Enter Doze mode during idle"
	help
	  Turning on this option will put the CPU into Doze mode during idle.
	  The default is to enter Wait mode during idle. Doze mode during
	  idle will save additional power over Wait mode.

config MXC_SDMA_API
        bool "Use SDMA API"
        default y
        help
           This selects the Freescale MXC SDMA API.
           If unsure, say N.

config ARCH_MXC_HAS_NFC_V1
        bool "MXC NFC Hardware Version 1"
	depends on !(MACH_MX31ADS && XIP_KERNEL)
        default y
        help
           This selects the Freescale MXC Nand Flash Controller Hardware Version 1
           If unsure, say N.

config ARCH_MXC_HAS_NFC_V2
        bool "MXC NFC Hardware Version 2"
	depends on !(MACH_MX31ADS && XIP_KERNEL)
        default y
        help
           This selects the Freescale MXC Nand Flash Controller Hardware Version 2
           If unsure, say N.

menu "Device options"

config I2C_MXC_SELECT1
	bool "Enable I2C1 module"
	default y
	depends on I2C_MXC
	help
	  Enable MX31 I2C1 module.

config I2C_MXC_SELECT2
	bool "Enable I2C2 module"
	default n
	depends on I2C_MXC
	help
	  Enable MX31 I2C2 module.

config I2C_MXC_SELECT3
	bool "Enable I2C3 module"
	default n
	depends on I2C_MXC
	help
	  Enable MX31 I2C3 module.

config SDHC_MXC_SELECT1
	bool "Enable SDHC1 module"
	default y
	depends on MMC_MXC
	help
	  Enable MX31 SDHC1 module.

config SDHC_MXC_SELECT2
	bool "Enable SDHC2 module"
	default n
	depends on MMC_MXC
	help
	  Enable MX31 SDHC2 module.

config SERIAL_MXC_PORT1
	bool "Enable UART port 1"
	default y
	depends on SERIAL_MXC
	help
	  Enable MX31 UART port 1.

config SERIAL_MXC_PORT2
	bool "Enable UART port 2"
	default n
	depends on SERIAL_MXC
	help
	  Enable MX31 UART port 2.

config SERIAL_MXC_PORT3
	bool "Enable UART port 3"
	default n
	depends on SERIAL_MXC
	help
	  Enable MX31 UART port 3.

config SERIAL_MXC_PORT4
	bool "Enable UART port 4"
	default n
	depends on SERIAL_MXC
	help
	  Enable MX31 UART port 4.

config SERIAL_MXC_PORT5
	bool "Enable UART port 5"
	default n
	depends on SERIAL_MXC
	help
	  Enable MX31 UART port 5.

endmenu

endmenu
```

## linux-2.6.26-at22/drivers/mxc/adc/Kconfig
```kconfig
#
# i.MX ADC devices
#

menu "MXC ADC support"

config IMX_ADC
	tristate "enable ADC driver"
	depends on ARCH_MXC
	default n
	help
	   This selects the Freescale i.MX on-chip ADC driver.

config USE_INTERNAL_REF_FOR_GENERAL_ADC
	bool "Use internal reference voltage for general ADC"
	depends on IMX_ADC
	default n
	help
	  Say Y here to use internal reference voltage (2.5V) for
	  general ADC. If you say N, use external reference voltage
	  (ADC_REF).

endmenu
```

## linux-2.6.26-at22/drivers/mxc/pmic/Kconfig
```kconfig
#
# PMIC device driver configuration
#

menu "MXC PMIC support"

config MXC_SPI_PMIC_CORE
	tristate "PMIC Protocol support (SPI interface)"
	depends on ARCH_MXC && SPI_MXC
	default n
	---help---
      	This is the PMIC core/protocol driver for the Freescale MXC application.
	SPI should be providing the interface between the PMIC and the MCU.
	You must select the SPI driver support to enable this option.

config MXC_PMIC
	boolean
	default MXC_SPI_PMIC_CORE

config MXC_PMIC_CHARDEV
	tristate "MXC PMIC device interface"
	depends on MXC_PMIC
	help
	  Say Y here to use "pmic" device files, found in the /dev directory
	  on the system.  They make it possible to have user-space programs
	  use or controll PMIC. Mainly its useful for notifying PMIC events
	  to user-space programs.

comment "MXC PMIC Client Drivers"
	depends on MXC_PMIC

config MXC_PMIC_MC34704
	tristate "MC34704 PMIC"
	depends on ARCH_MXC && I2C
	select MXC_PMIC
	  ---help---
	  This is the MXC MC34704 PMIC support.

endmenu
```

## linux-2.6.26-at22/drivers/mxc/pwm/Kconfig
```kconfig
#
# i.MX PWM devices
#

menu "MXC PWM support"

config MXC_PWM
	bool "Enable PWM driver"
	depends on ARCH_MXC
	select HAVE_PWM
	help
	  Enable support for the i.MX PWM controller(s).

config MXC_PWM_DEBUG
	bool "MXC PWM debuggind messages"
	depends on ARCH_MXC
	default n
	help
	  Say Y here if you want the MXC PWM driver to produce a bunch of debug
	  messages to the system log.

config MXC_PWM_CLASS
	bool "MXC PWM class support"
	depends on MXC_PWM
        default y
	help
	  This option enables the mxc pwm sysfs class in
	  /sys/class/mxc_pwm.  You'll need this to do anything useful
	  with PWMs.  If unsure, say N.

endmenu
```

## linux-2.6.26-at22/drivers/regulator/Kconfig
```kconfig
menu "Voltage and Current regulators"

config REGULATOR_API
	bool

config REGULATOR
	tristate "Voltage and Current Regulator Support"
	depends on EXPERIMENTAL
	select REGULATOR_API
	default n
	help
	  Generic Voltage and Current Regulator support.

config REGULATOR_DEBUG
	bool "Regulator debug support"
	depends on REGULATOR
	help
	  Say yes here to enable debugging support.

config REGULATOR_FIXED_VOLTAGE
	tristate "Fixed voltage regulator support"
	depends on REGULATOR
	help
	  This driver provides support for fixed voltage regulators,
	  useful for systems which use a combination of software
	  managed regulators and simple non-configurable regulators.

config REGULATOR_MC34704
	tristate "MC34704 Regulator Support"
	depends on REGULATOR
	depends on MXC_PMIC_MC34704
	default y

endmenu
```

## linux-2.6.26-at22/drivers/video/mxc/Kconfig
```kconfig
config FB_MXC
	tristate "MXC Framebuffer support"
	depends on FB && ARCH_MXC && (MXC_IPU || ARCH_MX27 || ARCH_MX25)
	select FB_CFB_FILLRECT
	select FB_CFB_COPYAREA
	select FB_CFB_IMAGEBLIT
	default y
	help
	  This is a framebuffer device for the MXC LCD Controller.
	  See <http://www.linux-fbdev.org/> for information on framebuffer
	  devices.

	  If you plan to use the LCD display with your MXC system, say
	  Y here.

choice
	prompt "Default videomode"
	depends on FB_MXC
	default FB_MXC_MODE_SHARP_QVGA if MACH_MX31ADS
	default FB_MXC_MODE_CRT_VGA if MACH_ARMADILLO500
	default FB_MXC_MODE_KYOCERA_VGA if MACH_ARMADILLO500FX
	default FB_MXC_MODE_ET043005DH6 if MACH_ARMADILLO410 || MACH_ARMADILLO440 || MACH_ARMADILLO460

config FB_MXC_MODE_SHARP_QVGA
	bool "Sharp-QVGA"
config FB_MXC_MODE_SHARP_CLI
	bool "Sharp-CLI"
config FB_MXC_MODE_SHARP_LS037V7DW01_VGA
	bool "Sharp-LS037V7DW01-VGA"
config FB_MXC_MODE_NEC_VGA
	bool "NEC-VGA"
config FB_MXC_MODE_TV_NTSC
	bool "TV-NTSC"
config FB_MXC_MODE_TV_PAL
	bool "TV-PAL"
config FB_MXC_MODE_TV_VGA
	bool "TV-VGA"
config FB_MXC_MODE_CRT_VGA
	bool "CRT-VGA"
config FB_MXC_MODE_CRT_SVGA
	bool "CRT-SVGA"
config FB_MXC_MODE_CRT_SVGA56
	bool "CRT-SVGA56 (for HSP 177MHz)"
config FB_MXC_MODE_CRT_SVGA60
	bool "CRT-SVGA60 (for HSP 177MHz)"
config FB_MXC_MODE_KYOCERA_VGA
	bool "KYOCERA-VGA"
config FB_MXC_MODE_CPT_VGA
	bool "CPT-VGA"
config FB_MXC_MODE_ET043005DH6
	bool "ET043005DH6"
config FB_MXC_MODE_VGG322423
	bool "VGG322423"
config FB_MXC_MODE_FG040360DSSWBG03
	bool "FG040360DSSWBG03"
config FB_MXC_MODE_FG050720DSSWDGT1
	bool "FG050720DSSWDGT1"
config FB_MXC_MODE_FG100410DNCWBGT1
	bool "FG100410DNCWBGT1"
config FB_MXC_MODE_AA043MA01
	bool "AA043MA01"

endchoice

config FB_MXC_DEFAULT_VIDEOMODE
	string
	depends on FB_MXC
	default "Sharp-QVGA" if FB_MXC_MODE_SHARP_QVGA
	default "Sharp-CLI" if FB_MXC_MODE_SHARP_CLI
	default "Sharp-LS037V7DW01-VGA" if FB_MXC_MODE_SHARP_LS037V7DW01_VGA
	default "NEC-VGA" if FB_MXC_MODE_NEC_VGA
	default "TV-NTSC" if FB_MXC_MODE_TV_NTSC
	default "TV-PAL" if FB_MXC_MODE_TV_PAL
	default "TV-VGA" if FB_MXC_MODE_TV_VGA
	default "CRT-VGA" if FB_MXC_MODE_CRT_VGA
	default "CRT-SVGA" if FB_MXC_MODE_CRT_SVGA
	default "CRT-SVGA56" if FB_MXC_MODE_CRT_SVGA56
	default "CRT-SVGA60" if FB_MXC_MODE_CRT_SVGA60
	default "KYOCERA-VGA" if FB_MXC_MODE_KYOCERA_VGA
        default "CPT-VGA" if FB_MXC_MODE_CPT_VGA
	default "ET043005DH6" if FB_MXC_MODE_ET043005DH6
	default "VGG322423" if FB_MXC_MODE_VGG322423
	default "FG040360DSSWBG03" if FB_MXC_MODE_FG040360DSSWBG03
	default "FG050720DSSWDGT1" if FB_MXC_MODE_FG050720DSSWDGT1
	default "FG100410DNCWBGT1" if FB_MXC_MODE_FG100410DNCWBGT1
	default "AA043MA01" if FB_MXC_MODE_AA043MA01

choice
	prompt "Default bpp"
	depends on FB_MXC
	default FB_MXC_BPP_16

config FB_MXC_BPP_16
	bool "16"
config FB_MXC_BPP_24
	bool "24"
config FB_MXC_BPP_32
	bool "32"

endchoice

config FB_MXC_DEFAULT_BPP
	int
	depends on FB_MXC
	default 16 if FB_MXC_BPP_16
	default 24 if FB_MXC_BPP_24
	default 32 if FB_MXC_BPP_32

config FB_MXC_DEFAULT_STATE
	int
	depends on FB_MXC
	default 1

config FB_MXC_SYNC_PANEL
	depends on FB_MXC
	tristate "Synchronous Panel Framebuffer"
	default y

config FB_MXC_TVOUT
	tristate "TV Out Encoder"
	depends on FB_MXC_SYNC_PANEL
	default n

config FB_MXC_LOW_PWR_DISPLAY
	bool "Low Power Display Refresh Mode"
	depends on FB_MXC_SYNC_PANEL && MXC_FB_IRAM
	default y

config FB_MXC_ASYNC_PANEL
	depends on FB_MXC
	bool "Asynchronous Panels"
	default n

menu "Asynchronous Panel Type"
	depends on FB_MXC_ASYNC_PANEL && FB_MXC

config FB_MXC_EPSON_PANEL
    depends on FB_MXC_ASYNC_PANEL
	default n
	bool "Epson 176x220 Panel"

endmenu

choice
	prompt "Async Panel Interface Type"
	depends on FB_MXC_ASYNC_PANEL && FB_MXC
	default FB_MXC_ASYNC_PANEL_IFC_16_BIT

config FB_MXC_ASYNC_PANEL_IFC_8_BIT
	bool "8-bit Parallel Bus Interface"

config FB_MXC_ASYNC_PANEL_IFC_16_BIT
	bool "16-bit Parallel Bus Interface"

config FB_MXC_ASYNC_PANEL_IFC_SERIAL
	bool "Serial Bus Interface"

endchoice
```

## linux-2.6.26-at22/sound/mips/Kconfig
```kconfig
# ALSA MIPS drivers

menu "ALSA MIPS devices"
	depends on SND!=n && MIPS

config SND_AU1X00
	tristate "Au1x00 AC97 Port Driver"
	depends on (SOC_AU1000 || SOC_AU1100 || SOC_AU1500) && SND
	select SND_PCM
	select SND_AC97_CODEC
	help
	  ALSA Sound driver for the Au1x00's AC97 port.

config SND_SGI_O2
	tristate "SGI O2 Audio"
	depends on  SND && SGI_IP32
        help
                Sound support for the SGI O2 Workstation. 

endmenu
```

## linux-2.6.26-at22/sound/soc/imx/Kconfig
```kconfig
config SND_MXC_SOC
	tristate "SoC Audio for the Freescale i.MX CPU"
	depends on ARCH_MXC && SND
	select SND_PCM
	help
	  Say Y or M if you want to add support for codecs attached to
	  the MXC AC97, I2S or SSP interface. You will also need
	  to select the audio interfaces to support below.

config SND_MXC_AC97
	tristate
	select SND_AC97_CODEC

config SND_MXC_SOC_AC97
	tristate
	select AC97_BUS

config SND_MXC_SOC_SSI
	tristate

config SND_SOC_IMX31ADS_WM8753
	tristate "SoC Audio support for MX31 - WM8753"
	depends on SND_MXC_SOC && ARCH_MX3
	select SND_MXC_SOC_SSI
	select SND_SOC_WM8753
	help
	  Say Y if you want to add support for SoC audio on MX31ADS
	  with the WM8753.

config SND_SOC_IMX32ADS_WM8350
	tristate "SoC Audio support for MX31 - WM8350"
	depends on SND_MXC_SOC && ARCH_MX3 && REGULATOR_WM8350
	select SND_MXC_SOC_SSI
	select SND_SOC_WM8350
	help
	  Say Y if you want to add support for SoC audio on MX32ADS
	  with the WM8350.

config SND_SOC_ARMADILLO500FX_WM8978
	tristate "SoC Audio support for Armadillo-500 FX - WM8978"
	depends on SND_MXC_SOC && ARCH_MX3
	select SND_MXC_SOC_SSI
	select SND_SOC_WM8978
	help
	  Say Y if you want to add support for SoC audio on Armadillo-500 FX
	  with the WM8978.

config SND_SOC_ARMADILLO440_WM8978
	tristate "SoC Audio support for Armadillo-440 - WM8978"
	depends on ARCH_MX25 && (ARMADILLO400_AUD5_CON11 || ARMADILLO400_AUD6_CON9)
	select SND_MXC_SOC_SSI
	select SND_SOC_WM8978
	help
	  Say Y if you want to add support for SoC audio on Armadillo-440
	  with the WM8978.
```
