## atmark-dist-20150127/config.in
```kconfig
mainmenu_name 'SnapGear Embedded Linux Configuration'
mainmenu_option next_comment
comment 'Vendor/Product Selection'
comment 'Select the Vendor you wish to target'
choice 'Vendor' "3com CONFIG_DEFAULTS_3COM \
ADI CONFIG_DEFAULTS_ADI \
Akizuki CONFIG_DEFAULTS_AKIZUKI \
Apple CONFIG_DEFAULTS_APPLE \
Arcturus CONFIG_DEFAULTS_ARCTURUS \
Arnewsh CONFIG_DEFAULTS_ARNEWSH \
AtmarkTechno CONFIG_DEFAULTS_ATMARKTECHNO \
Atmel CONFIG_DEFAULTS_ATMEL \
Avnet CONFIG_DEFAULTS_AVNET \
Cirrus CONFIG_DEFAULTS_CIRRUS \
Cogent CONFIG_DEFAULTS_COGENT \
Conexant CONFIG_DEFAULTS_CONEXANT \
Cwlinux CONFIG_DEFAULTS_CWLINUX \
CyberGuard CONFIG_DEFAULTS_CYBERGUARD \
Cytek CONFIG_DEFAULTS_CYTEK \
Exys CONFIG_DEFAULTS_EXYS \
Feith CONFIG_DEFAULTS_FEITH \
Future CONFIG_DEFAULTS_FUTURE \
GDB CONFIG_DEFAULTS_GDB \
Hitachi CONFIG_DEFAULTS_HITACHI \
Imt CONFIG_DEFAULTS_IMT \
Insight CONFIG_DEFAULTS_INSIGHT \
Intel CONFIG_DEFAULTS_INTEL \
KendinMicrel CONFIG_DEFAULTS_KENDINMICREL \
LEOX CONFIG_DEFAULTS_LEOX \
Mecel CONFIG_DEFAULTS_MECEL \
Midas CONFIG_DEFAULTS_MIDAS \
Motorola CONFIG_DEFAULTS_MOTOROLA \
NEC CONFIG_DEFAULTS_NEC \
NetSilicon CONFIG_DEFAULTS_NETSILICON \
Netburner CONFIG_DEFAULTS_NETBURNER \
Nintendo CONFIG_DEFAULTS_NINTENDO \
OPENcores CONFIG_DEFAULTS_OPENCORES \
Promise CONFIG_DEFAULTS_PROMISE \
SNEHA CONFIG_DEFAULTS_SNEHA \
SSV CONFIG_DEFAULTS_SSV \
SWARM CONFIG_DEFAULTS_SWARM \
Samsung CONFIG_DEFAULTS_SAMSUNG \
SecureEdge CONFIG_DEFAULTS_SECUREEDGE \
Signal CONFIG_DEFAULTS_SIGNAL \
SnapGear CONFIG_DEFAULTS_SNAPGEAR \
Soekris CONFIG_DEFAULTS_SOEKRIS \
Sony CONFIG_DEFAULTS_SONY \
StrawberryLinux CONFIG_DEFAULTS_STRAWBERRYLINUX \
TI CONFIG_DEFAULTS_TI \
TeleIP CONFIG_DEFAULTS_TELEIP \
Triscend CONFIG_DEFAULTS_TRISCEND \
Via CONFIG_DEFAULTS_VIA \
Weiss CONFIG_DEFAULTS_WEISS \
Xilinx CONFIG_DEFAULTS_XILINX \
senTec CONFIG_DEFAULTS_SENTEC \
" SnapGear
comment 'Select the Product you wish to target'
if [ "$CONFIG_DEFAULTS_3COM" = "y" ]; then
choice '3com Products' "PalmIIIx CONFIG_DEFAULTS_3COM_PALMIIIX \
Xcopilot CONFIG_DEFAULTS_3COM_XCOPILOT \
" PalmIIIx
fi
if [ "$CONFIG_DEFAULTS_ADI" = "y" ]; then
choice 'ADI Products' "Coyote CONFIG_DEFAULTS_ADI_COYOTE \
" Coyote
fi
if [ "$CONFIG_DEFAULTS_AKIZUKI" = "y" ]; then
choice 'Akizuki Products' "AE3068 CONFIG_DEFAULTS_AKIZUKI_AE3068 \
" AE3068
fi
if [ "$CONFIG_DEFAULTS_APPLE" = "y" ]; then
choice 'Apple Products' "iPod CONFIG_DEFAULTS_APPLE_IPOD \
" iPod
fi
if [ "$CONFIG_DEFAULTS_ARCTURUS" = "y" ]; then
choice 'Arcturus Products' "uC5272 CONFIG_DEFAULTS_ARCTURUS_UC5272 \
uCdimm CONFIG_DEFAULTS_ARCTURUS_UCDIMM \
uCdimm+mtd CONFIG_DEFAULTS_ARCTURUS_UCDIMM_MTD \
uCquicc CONFIG_DEFAULTS_ARCTURUS_UCQUICC \
uCsimm CONFIG_DEFAULTS_ARCTURUS_UCSIMM \
" uC5272
fi
if [ "$CONFIG_DEFAULTS_ARNEWSH" = "y" ]; then
choice 'Arnewsh Products' "M5206 CONFIG_DEFAULTS_ARNEWSH_M5206 \
M5307 CONFIG_DEFAULTS_ARNEWSH_M5307 \
" M5206
fi
if [ "$CONFIG_DEFAULTS_ATMARKTECHNO" = "y" ]; then
choice 'AtmarkTechno Products' "Armadillo-210.Base CONFIG_DEFAULTS_ATMARKTECHNO_ARMADILLO_210_BASE \
Armadillo-210.Recover CONFIG_DEFAULTS_ATMARKTECHNO_ARMADILLO_210_RECOVER \
Armadillo-220.Base CONFIG_DEFAULTS_ATMARKTECHNO_ARMADILLO_220_BASE \
Armadillo-220.Recover CONFIG_DEFAULTS_ATMARKTECHNO_ARMADILLO_220_RECOVER \
Armadillo-230.Base CONFIG_DEFAULTS_ATMARKTECHNO_ARMADILLO_230_BASE \
Armadillo-230.Recover CONFIG_DEFAULTS_ATMARKTECHNO_ARMADILLO_230_RECOVER \
Armadillo-240.Base CONFIG_DEFAULTS_ATMARKTECHNO_ARMADILLO_240_BASE \
Armadillo-240.Recover CONFIG_DEFAULTS_ATMARKTECHNO_ARMADILLO_240_RECOVER \
Armadillo-300 CONFIG_DEFAULTS_ATMARKTECHNO_ARMADILLO_300 \
Armadillo-420 CONFIG_DEFAULTS_ATMARKTECHNO_ARMADILLO_420 \
Armadillo-420.WLAN-AWL12 CONFIG_DEFAULTS_ATMARKTECHNO_ARMADILLO_420_WLAN_AWL12 \
Armadillo-420.WLAN-AWL13 CONFIG_DEFAULTS_ATMARKTECHNO_ARMADILLO_420_WLAN_AWL13 \
Armadillo-440 CONFIG_DEFAULTS_ATMARKTECHNO_ARMADILLO_440 \
Armadillo-460 CONFIG_DEFAULTS_ATMARKTECHNO_ARMADILLO_460 \
Armadillo-500 CONFIG_DEFAULTS_ATMARKTECHNO_ARMADILLO_500 \
Armadillo-500-FX.base CONFIG_DEFAULTS_ATMARKTECHNO_ARMADILLO_500_FX_BASE \
Armadillo-500-FX.dev CONFIG_DEFAULTS_ATMARKTECHNO_ARMADILLO_500_FX_DEV \
Armadillo-810 CONFIG_DEFAULTS_ATMARKTECHNO_ARMADILLO_810 \
Armadillo-840 CONFIG_DEFAULTS_ATMARKTECHNO_ARMADILLO_840 \
Armadillo-9 CONFIG_DEFAULTS_ATMARKTECHNO_ARMADILLO_9 \
Armadillo-9.PCMCIA CONFIG_DEFAULTS_ATMARKTECHNO_ARMADILLO_9_PCMCIA \
Armadillo-IoTG-Std CONFIG_DEFAULTS_ATMARKTECHNO_ARMADILLO_IOTG_STD \
SUZAKU-V.SZ310 CONFIG_DEFAULTS_ATMARKTECHNO_SUZAKU_V_SZ310 \
SUZAKU-V.SZ310-SID CONFIG_DEFAULTS_ATMARKTECHNO_SUZAKU_V_SZ310_SID \
SUZAKU-V.SZ310-SIL CONFIG_DEFAULTS_ATMARKTECHNO_SUZAKU_V_SZ310_SIL \
SUZAKU-V.SZ310-SIL-GPIO CONFIG_DEFAULTS_ATMARKTECHNO_SUZAKU_V_SZ310_SIL_GPIO \
SUZAKU-V.SZ410 CONFIG_DEFAULTS_ATMARKTECHNO_SUZAKU_V_SZ410 \
SUZAKU-V.SZ410-SID CONFIG_DEFAULTS_ATMARKTECHNO_SUZAKU_V_SZ410_SID \
SUZAKU-V.SZ410-SIL CONFIG_DEFAULTS_ATMARKTECHNO_SUZAKU_V_SZ410_SIL \
SUZAKU-V.SZ410-SIL-GPIO CONFIG_DEFAULTS_ATMARKTECHNO_SUZAKU_V_SZ410_SIL_GPIO \
SUZAKU-V.SZ410-SIV CONFIG_DEFAULTS_ATMARKTECHNO_SUZAKU_V_SZ410_SIV \
" Armadillo-210.Base
fi
if [ "$CONFIG_DEFAULTS_ATMEL" = "y" ]; then
choice 'Atmel Products' "AT91 CONFIG_DEFAULTS_ATMEL_AT91 \
" AT91
fi
if [ "$CONFIG_DEFAULTS_AVNET" = "y" ]; then
choice 'Avnet Products' "AVNET5282 CONFIG_DEFAULTS_AVNET_AVNET5282 \
" AVNET5282
fi
if [ "$CONFIG_DEFAULTS_CIRRUS" = "y" ]; then
choice 'Cirrus Products' "EDB9312 CONFIG_DEFAULTS_CIRRUS_EDB9312 \
" EDB9312
fi
if [ "$CONFIG_DEFAULTS_COGENT" = "y" ]; then
choice 'Cogent Products' "CSB337 CONFIG_DEFAULTS_COGENT_CSB337 \
" CSB337
fi
if [ "$CONFIG_DEFAULTS_CONEXANT" = "y" ]; then
choice 'Conexant Products' "Humber CONFIG_DEFAULTS_CONEXANT_HUMBER \
P52 CONFIG_DEFAULTS_CONEXANT_P52 \
" Humber
fi
if [ "$CONFIG_DEFAULTS_CWLINUX" = "y" ]; then
choice 'Cwlinux Products' "cwez328 CONFIG_DEFAULTS_CWLINUX_CWEZ328 \
cwvz328 CONFIG_DEFAULTS_CWLINUX_CWVZ328 \
" cwez328
fi
if [ "$CONFIG_DEFAULTS_CYBERGUARD" = "y" ]; then
choice 'CyberGuard Products' "SE4500 CONFIG_DEFAULTS_CYBERGUARD_SE4500 \
SG300 CONFIG_DEFAULTS_CYBERGUARD_SG300 \
SG530 CONFIG_DEFAULTS_CYBERGUARD_SG530 \
SG550 CONFIG_DEFAULTS_CYBERGUARD_SG550 \
SG560 CONFIG_DEFAULTS_CYBERGUARD_SG560 \
SG565 CONFIG_DEFAULTS_CYBERGUARD_SG565 \
SG570 CONFIG_DEFAULTS_CYBERGUARD_SG570 \
SG575 CONFIG_DEFAULTS_CYBERGUARD_SG575 \
SG580 CONFIG_DEFAULTS_CYBERGUARD_SG580 \
SG630 CONFIG_DEFAULTS_CYBERGUARD_SG630 \
SG635 CONFIG_DEFAULTS_CYBERGUARD_SG635 \
SG710 CONFIG_DEFAULTS_CYBERGUARD_SG710 \
SG810 CONFIG_DEFAULTS_CYBERGUARD_SG810 \
" SE4500
fi
if [ "$CONFIG_DEFAULTS_CYTEK" = "y" ]; then
choice 'Cytek Products' "NETmp3 CONFIG_DEFAULTS_CYTEK_NETMP3 \
" NETmp3
fi
if [ "$CONFIG_DEFAULTS_EXYS" = "y" ]; then
choice 'Exys Products' "de2 CONFIG_DEFAULTS_EXYS_DE2 \
" de2
fi
if [ "$CONFIG_DEFAULTS_FEITH" = "y" ]; then
choice 'Feith Products' "CANCam CONFIG_DEFAULTS_FEITH_CANCAM \
Cleopatra CONFIG_DEFAULTS_FEITH_CLEOPATRA \
Cleopatra2 CONFIG_DEFAULTS_FEITH_CLEOPATRA2 \
SCALES CONFIG_DEFAULTS_FEITH_SCALES \
" CANCam
fi
if [ "$CONFIG_DEFAULTS_FUTURE" = "y" ]; then
choice 'Future Products' "FutureNetburner5282Badge CONFIG_DEFAULTS_FUTURE_FUTURENETBURNER5282BADGE \
" FutureNetburner5282Badge
fi
if [ "$CONFIG_DEFAULTS_GDB" = "y" ]; then
choice 'GDB Products' "ARMulator CONFIG_DEFAULTS_GDB_ARMULATOR \
ARMulator-EB CONFIG_DEFAULTS_GDB_ARMULATOR_EB \
SkyEye CONFIG_DEFAULTS_GDB_SKYEYE \
" ARMulator
fi
if [ "$CONFIG_DEFAULTS_HITACHI" = "y" ]; then
choice 'Hitachi Products' "BigSurIV CONFIG_DEFAULTS_HITACHI_BIGSURIV \
EDOSK2674 CONFIG_DEFAULTS_HITACHI_EDOSK2674 \
KeyWest CONFIG_DEFAULTS_HITACHI_KEYWEST \
" BigSurIV
fi
if [ "$CONFIG_DEFAULTS_IMT" = "y" ]; then
choice 'Imt Products' "mwi CONFIG_DEFAULTS_IMT_MWI \
" mwi
fi
if [ "$CONFIG_DEFAULTS_INSIGHT" = "y" ]; then
choice 'Insight Products' "XC2V1K_Microblaze CONFIG_DEFAULTS_INSIGHT_XC2V1K_MICROBLAZE \
XC2VP7_Microblaze CONFIG_DEFAULTS_INSIGHT_XC2VP7_MICROBLAZE \
mbvanilla_net CONFIG_DEFAULTS_INSIGHT_MBVANILLA_NET \
" XC2V1K_Microblaze
fi
if [ "$CONFIG_DEFAULTS_INTEL" = "y" ]; then
choice 'Intel Products' "IXDP2800 CONFIG_DEFAULTS_INTEL_IXDP2800 \
IXDP425 CONFIG_DEFAULTS_INTEL_IXDP425 \
MonteJade CONFIG_DEFAULTS_INTEL_MONTEJADE \
" IXDP2800
fi
if [ "$CONFIG_DEFAULTS_KENDINMICREL" = "y" ]; then
choice 'KendinMicrel Products' "KS8695 CONFIG_DEFAULTS_KENDINMICREL_KS8695 \
" KS8695
fi
if [ "$CONFIG_DEFAULTS_LEOX" = "y" ]; then
choice 'LEOX Products' "TSIM CONFIG_DEFAULTS_LEOX_TSIM \
" TSIM
fi
if [ "$CONFIG_DEFAULTS_MECEL" = "y" ]; then
choice 'Mecel Products' "FR1000 CONFIG_DEFAULTS_MECEL_FR1000 \
" FR1000
fi
if [ "$CONFIG_DEFAULTS_MIDAS" = "y" ]; then
choice 'Midas Products' "RTE-NB85E-CB CONFIG_DEFAULTS_MIDAS_RTE_NB85E_CB \
RTE-V850E-MA1-CB CONFIG_DEFAULTS_MIDAS_RTE_V850E_MA1_CB \
RTE-V850E-ME2-CB CONFIG_DEFAULTS_MIDAS_RTE_V850E_ME2_CB \
" RTE-NB85E-CB
fi
if [ "$CONFIG_DEFAULTS_MOTOROLA" = "y" ]; then
choice 'Motorola Products' "M5206eC3 CONFIG_DEFAULTS_MOTOROLA_M5206EC3 \
M5206eLITE CONFIG_DEFAULTS_MOTOROLA_M5206ELITE \
M5235EVB CONFIG_DEFAULTS_MOTOROLA_M5235EVB \
M5249C3 CONFIG_DEFAULTS_MOTOROLA_M5249C3 \
M5271EVB CONFIG_DEFAULTS_MOTOROLA_M5271EVB \
M5272C3 CONFIG_DEFAULTS_MOTOROLA_M5272C3 \
M5275EVB CONFIG_DEFAULTS_MOTOROLA_M5275EVB \
M5282EVB CONFIG_DEFAULTS_MOTOROLA_M5282EVB \
M5282LITE CONFIG_DEFAULTS_MOTOROLA_M5282LITE \
M5307C3 CONFIG_DEFAULTS_MOTOROLA_M5307C3 \
M5407C3 CONFIG_DEFAULTS_MOTOROLA_M5407C3 \
M5475EVB CONFIG_DEFAULTS_MOTOROLA_M5475EVB \
" M5206eC3
fi
if [ "$CONFIG_DEFAULTS_NEC" = "y" ]; then
choice 'NEC Products' "Anna CONFIG_DEFAULTS_NEC_ANNA \
common CONFIG_DEFAULTS_NEC_COMMON \
v850e-sim-gdb CONFIG_DEFAULTS_NEC_V850E_SIM_GDB \
" Anna
fi
if [ "$CONFIG_DEFAULTS_NETSILICON" = "y" ]; then
choice 'NetSilicon Products' "AT-9750LX CONFIG_DEFAULTS_NETSILICON_AT_9750LX \
NET+ARM CONFIG_DEFAULTS_NETSILICON_NET_ARM \
" AT-9750LX
fi
if [ "$CONFIG_DEFAULTS_NETBURNER" = "y" ]; then
choice 'Netburner Products' "CFV240 CONFIG_DEFAULTS_NETBURNER_CFV240 \
MOD5272 CONFIG_DEFAULTS_NETBURNER_MOD5272 \
MOD5282 CONFIG_DEFAULTS_NETBURNER_MOD5282 \
" CFV240
fi
if [ "$CONFIG_DEFAULTS_NINTENDO" = "y" ]; then
choice 'Nintendo Products' "GBA CONFIG_DEFAULTS_NINTENDO_GBA \
" GBA
fi
if [ "$CONFIG_DEFAULTS_OPENCORES" = "y" ]; then
choice 'OPENcores Products' "or32 CONFIG_DEFAULTS_OPENCORES_OR32 \
" or32
fi
if [ "$CONFIG_DEFAULTS_PROMISE" = "y" ]; then
choice 'Promise Products' "SX6 CONFIG_DEFAULTS_PROMISE_SX6 \
" SX6
fi
if [ "$CONFIG_DEFAULTS_SNEHA" = "y" ]; then
choice 'SNEHA Products' "CPU16B CONFIG_DEFAULTS_SNEHA_CPU16B \
" CPU16B
fi
if [ "$CONFIG_DEFAULTS_SSV" = "y" ]; then
choice 'SSV Products' "DNP5280 CONFIG_DEFAULTS_SSV_DNP5280 \
" DNP5280
fi
if [ "$CONFIG_DEFAULTS_SWARM" = "y" ]; then
choice 'SWARM Products' "SWARM CONFIG_DEFAULTS_SWARM_SWARM \
" SWARM
fi
if [ "$CONFIG_DEFAULTS_SAMSUNG" = "y" ]; then
choice 'Samsung Products' "4510B CONFIG_DEFAULTS_SAMSUNG_4510B \
" 4510B
fi
if [ "$CONFIG_DEFAULTS_SECUREEDGE" = "y" ]; then
choice 'SecureEdge Products' "DISKtel CONFIG_DEFAULTS_SECUREEDGE_DISKTEL \
MP3 CONFIG_DEFAULTS_SECUREEDGE_MP3 \
NETtel1500 CONFIG_DEFAULTS_SECUREEDGE_NETTEL1500 \
NETtel3540 CONFIG_DEFAULTS_SECUREEDGE_NETTEL3540 \
SecureEdge1100 CONFIG_DEFAULTS_SECUREEDGE_SECUREEDGE1100 \
SecureEdge2540 CONFIG_DEFAULTS_SECUREEDGE_SECUREEDGE2540 \
SecureEdge2570 CONFIG_DEFAULTS_SECUREEDGE_SECUREEDGE2570 \
SecureEdge2580 CONFIG_DEFAULTS_SECUREEDGE_SECUREEDGE2580 \
SecureEdge2580-JFFS CONFIG_DEFAULTS_SECUREEDGE_SECUREEDGE2580_JFFS \
SecureEdgeEdna CONFIG_DEFAULTS_SECUREEDGE_SECUREEDGEEDNA \
SecureEdgeNAS CONFIG_DEFAULTS_SECUREEDGE_SECUREEDGENAS \
SecureEdgePCMCIA CONFIG_DEFAULTS_SECUREEDGE_SECUREEDGEPCMCIA \
SecureEdgeVPN CONFIG_DEFAULTS_SECUREEDGE_SECUREEDGEVPN \
eLIA CONFIG_DEFAULTS_SECUREEDGE_ELIA \
" DISKtel
fi
if [ "$CONFIG_DEFAULTS_SIGNAL" = "y" ]; then
choice 'Signal Products' "MCP751 CONFIG_DEFAULTS_SIGNAL_MCP751 \
" MCP751
fi
if [ "$CONFIG_DEFAULTS_SNAPGEAR" = "y" ]; then
choice 'SnapGear Products' "LITE CONFIG_DEFAULTS_SNAPGEAR_LITE \
LITE300 CONFIG_DEFAULTS_SNAPGEAR_LITE300 \
PRO CONFIG_DEFAULTS_SNAPGEAR_PRO \
SE2580 CONFIG_DEFAULTS_SNAPGEAR_SE2580 \
SE2580-JFFS CONFIG_DEFAULTS_SNAPGEAR_SE2580_JFFS \
SE2900 CONFIG_DEFAULTS_SNAPGEAR_SE2900 \
SE2910-CF CONFIG_DEFAULTS_SNAPGEAR_SE2910_CF \
SE2910-Intel CONFIG_DEFAULTS_SNAPGEAR_SE2910_INTEL \
SE3400 CONFIG_DEFAULTS_SNAPGEAR_SE3400 \
SE4000 CONFIG_DEFAULTS_SNAPGEAR_SE4000 \
SE5000 CONFIG_DEFAULTS_SNAPGEAR_SE5000 \
SME530 CONFIG_DEFAULTS_SNAPGEAR_SME530 \
SME550 CONFIG_DEFAULTS_SNAPGEAR_SME550 \
SME570 CONFIG_DEFAULTS_SNAPGEAR_SME570 \
SME575 CONFIG_DEFAULTS_SNAPGEAR_SME575 \
SOHO+ CONFIG_DEFAULTS_SNAPGEAR_SOHO_ \
" LITE
fi
if [ "$CONFIG_DEFAULTS_SOEKRIS" = "y" ]; then
choice 'Soekris Products' "net4801 CONFIG_DEFAULTS_SOEKRIS_NET4801 \
" net4801
fi
if [ "$CONFIG_DEFAULTS_SONY" = "y" ]; then
choice 'Sony Products' "Clie CONFIG_DEFAULTS_SONY_CLIE \
" Clie
fi
if [ "$CONFIG_DEFAULTS_STRAWBERRYLINUX" = "y" ]; then
choice 'StrawberryLinux Products' "H8MAX CONFIG_DEFAULTS_STRAWBERRYLINUX_H8MAX \
" H8MAX
fi
if [ "$CONFIG_DEFAULTS_TI" = "y" ]; then
choice 'TI Products' "dm270 CONFIG_DEFAULTS_TI_DM270 \
" dm270
fi
if [ "$CONFIG_DEFAULTS_TELEIP" = "y" ]; then
choice 'TeleIP Products' "rsc CONFIG_DEFAULTS_TELEIP_RSC \
" rsc
fi
if [ "$CONFIG_DEFAULTS_TRISCEND" = "y" ]; then
choice 'Triscend Products' "A7DB CONFIG_DEFAULTS_TRISCEND_A7DB \
DevA7 CONFIG_DEFAULTS_TRISCEND_DEVA7 \
" A7DB
fi
if [ "$CONFIG_DEFAULTS_VIA" = "y" ]; then
choice 'Via Products' "EPIA CONFIG_DEFAULTS_VIA_EPIA \
" EPIA
fi
if [ "$CONFIG_DEFAULTS_WEISS" = "y" ]; then
choice 'Weiss Products' "SM2010 CONFIG_DEFAULTS_WEISS_SM2010 \
" SM2010
fi
if [ "$CONFIG_DEFAULTS_XILINX" = "y" ]; then
choice 'Xilinx Products' "common CONFIG_DEFAULTS_XILINX_COMMON \
uclinux-auto CONFIG_DEFAULTS_XILINX_UCLINUX_AUTO \
" common
fi
if [ "$CONFIG_DEFAULTS_SENTEC" = "y" ]; then
choice 'senTec Products' "COBRA5272 CONFIG_DEFAULTS_SENTEC_COBRA5272 \
COBRA5282 CONFIG_DEFAULTS_SENTEC_COBRA5282 \
" COBRA5272
fi
endmenu
mainmenu_option next_comment
comment 'Kernel/Library/Defaults Selection'
comment 'Kernel is linux-2.6.x'
define_bool CONFIG_DEFAULTS_KERNEL_2_6 y
choice 'Cross-dev' "default CONFIG_DEFAULTS_CROSSDEV_DEFAULT \
arm-vfp CONFIG_DEFAULTS_CROSSDEV_ARM_VFP \
arm CONFIG_DEFAULTS_CROSSDEV_ARM \
armel CONFIG_DEFAULTS_CROSSDEV_ARMEL \
armhf CONFIG_DEFAULTS_CROSSDEV_ARMHF \
armnommu CONFIG_DEFAULTS_CROSSDEV_ARMNOMMU \
common CONFIG_DEFAULTS_CROSSDEV_COMMON \
h8300 CONFIG_DEFAULTS_CROSSDEV_H8300 \
host CONFIG_DEFAULTS_CROSSDEV_HOST \
i386 CONFIG_DEFAULTS_CROSSDEV_I386 \
i960 CONFIG_DEFAULTS_CROSSDEV_I960 \
m68knommu CONFIG_DEFAULTS_CROSSDEV_M68KNOMMU \
microblaze CONFIG_DEFAULTS_CROSSDEV_MICROBLAZE \
mips CONFIG_DEFAULTS_CROSSDEV_MIPS \
powerpc CONFIG_DEFAULTS_CROSSDEV_POWERPC \
sh CONFIG_DEFAULTS_CROSSDEV_SH \
" default
choice 'Libc Version' "None CONFIG_DEFAULTS_LIBC_NONE \
glibc CONFIG_DEFAULTS_LIBC_GLIBC \
uC-libc CONFIG_DEFAULTS_LIBC_UC_LIBC \
uClibc CONFIG_DEFAULTS_LIBC_UCLIBC \
" None
bool 'Default all settings (lose changes)'	CONFIG_DEFAULTS_OVERRIDE
bool 'Customize Kernel Settings'			CONFIG_DEFAULTS_KERNEL
bool 'Customize Vendor/User Settings'		CONFIG_DEFAULTS_VENDOR
bool 'Update Default Vendor Settings'		CONFIG_DEFAULTS_VENDOR_UPDATE
endmenu
```
